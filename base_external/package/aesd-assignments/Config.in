## base_external/package/aesd-assignments/Config.in
```kconfig
config BR2_PACKAGE_AESD_ASSIGNMENTS
	bool "aesd-assignments"
	help
	  Includes simple socket server from aesd-assignment 5.
	  Used to understand buildroot external trees and package builds.
```
